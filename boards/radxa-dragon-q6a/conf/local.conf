## boards/radxa-dragon-q6a/conf/local.conf
```bitbake
# Radxa Dragon Q6A (QCS6490) — local.conf
# Generated by sdyocto-setup-scripts

MACHINE ??= "sdradxa-dragon-q6a"

DISTRO ?= "poky"

PACKAGE_CLASSES ?= "package_ipk"

SDKMACHINE ?= "x86_64"

EXTRA_IMAGE_FEATURES ?= "debug-tweaks"

USER_CLASSES ?= "buildstats"

PATCHRESOLVE = "noop"

BB_DISKMON_DIRS ??= "\
    STOPTASKS,${TMPDIR},1G,100K \
    STOPTASKS,${DL_DIR},1G,100K \
    STOPTASKS,${SSTATE_DIR},1G,100K \
    STOPTASKS,/tmp,100M,100K \
    HALT,${TMPDIR},100M,1K \
    HALT,${DL_DIR},100M,1K \
    HALT,${SSTATE_DIR},100M,1K \
    HALT,/tmp,10M,1K"

CONF_VERSION = "2"

# Qualcomm / QCS6490 specific
PREFERRED_PROVIDER_virtual/kernel = "linux-linaro-qcomlt"
SERIAL_CONSOLES = "115200;ttyMSM0"
IMAGE_FSTYPES += "ext4"

# EFI boot support
DISTRO_FEATURES:append = " efi pam"

# systemd (usrmerge required by systemd in scarthgap)
DISTRO_FEATURES:append = " systemd usrmerge"
DISTRO_FEATURES:remove = " sysvinit"
VIRTUAL-RUNTIME_init_manager = "systemd"
VIRTUAL-RUNTIME_dev_manager = "udev"
VIRTUAL-RUNTIME_login_manager = "systemd"
VIRTUAL-RUNTIME_base-utils-syslog = "systemd"
VIRTUAL-RUNTIME_update-alternatives = "update-alternatives"
VIRTUAL-RUNTIME_base-utils = "busybox"
```

## boards/raspi/conf/local.conf
```bitbake
# Raspberry Pi — local.conf
# Generated by sdyocto-setup-scripts

MACHINE ??= "raspberrypi4-64"

DISTRO ?= "poky"

PACKAGE_CLASSES ?= "package_ipk"

SDKMACHINE ?= "x86_64"

EXTRA_IMAGE_FEATURES ?= "debug-tweaks"

USER_CLASSES ?= "buildstats"

PATCHRESOLVE = "noop"

BB_DISKMON_DIRS ??= "\
    STOPTASKS,${TMPDIR},1G,100K \
    STOPTASKS,${DL_DIR},1G,100K \
    STOPTASKS,${SSTATE_DIR},1G,100K \
    STOPTASKS,/tmp,100M,100K \
    HALT,${TMPDIR},100M,1K \
    HALT,${DL_DIR},100M,1K \
    HALT,${SSTATE_DIR},100M,1K \
    HALT,/tmp,10M,1K"

CONF_VERSION = "2"

# Raspberry Pi specific
ENABLE_UART = "1"
RPI_USE_U_BOOT = "1"

# systemd
DISTRO_FEATURES:append = " systemd"
DISTRO_FEATURES:remove = " sysvinit"
VIRTUAL-RUNTIME_init_manager = "systemd"
VIRTUAL-RUNTIME_dev_manager = "udev"
VIRTUAL-RUNTIME_login_manager = "systemd"
VIRTUAL-RUNTIME_base-utils-syslog = "systemd"
VIRTUAL-RUNTIME_update-alternatives = "update-alternatives"
VIRTUAL-RUNTIME_base-utils = "busybox"
```
